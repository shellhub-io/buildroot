## Config.in
```kconfig
menu "external packages"
source "$BR2_EXTERNAL_SHELLHUB_PATH/package/shellhub/Config.in"
endmenu
```

## package/shellhub/Config.in
```kconfig
config BR2_PACKAGE_SHELLHUB
	bool "shellhub"
        depends on BR2_PACKAGE_HOST_GO_TARGET_ARCH_SUPPORTS
        depends on BR2_PACKAGE_HOST_GO_TARGET_CGO_LINKING_SUPPORTS
        depends on BR2_TOOLCHAIN_HAS_THREADS
	select BR2_PACKAGE_LIBXCRYPT
	help
          Get seamless remote access to any Linux device.
          Centralized SSH for the edge and cloud computing.

	  https://github.com/shellhub-io/shellhub
```
